## custompackages/package/dropbear/Config.in
```kconfig
config BR2_PACKAGE_DROPBEAR
	bool "dropbear"
	select BR2_PACKAGE_ZLIB
	help
	  A small SSH 2 server/client designed for small memory
	  environments.

	  https://matt.ucc.asn.au/dropbear/dropbear.html

if BR2_PACKAGE_DROPBEAR

config BR2_PACKAGE_DROPBEAR_CLIENT
	bool "client programs"
	default y
	help
	  Enable the ssh client programs (dbclient/ssh).

config BR2_PACKAGE_DROPBEAR_DISABLE_REVERSEDNS
	bool "disable reverse DNS lookups"
	default y
	help
	  Disable reverse DNS lookups of incoming connections.

config BR2_PACKAGE_DROPBEAR_SMALL
	bool "optimize for size"
	default y
	help
	  Build dropbear with DROPBEAR_SMALL_CODE to reduce the
	  binary size.

endif
```
